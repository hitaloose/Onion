/* RG35XX with a 2100 mAh battery: battery table from the Garlic misc/dtbs/2100mAh.dtb */
/include/ "rg35xx.dts"

/ {
	i2c@b0174000 {
		atc2603c@65 {
			atc260x-cap-gauge {
				capacity = <0x834>;
				ocv_soc_00 = <0xc61 0xc7f 0xc8a 0xc90 0xc96 0xca8 0xcae 0xcb3 0xcb9 0xcc5>;
				ocv_soc_10 = <0xcd1 0xcdc 0xce8 0xcee 0xcfa 0xd11 0xd17 0xd1d 0xd23 0xd2f>;
				ocv_soc_20 = <0xd34 0xd3a 0xd40 0xd4c 0xd52 0xd58 0xd5d 0xd63 0xd6f 0xd75>;
				ocv_soc_30 = <0xd7b 0xd81 0xd8c 0xd92 0xd98 0xd9e 0xdaf 0xdbb 0xdc1 0xdc7>;
				ocv_soc_40 = <0xdcd 0xdd8 0xdde 0xde4 0xdea 0xdf0 0xdfc 0xe01 0xe07 0xe0d>;
				ocv_soc_50 = <0xe1f 0xe25 0xe2a 0xe30 0xe36 0xe42 0xe48 0xe4e 0xe53 0xe59>;
				ocv_soc_60 = <0xe65 0xe77 0xe7c 0xe82 0xe9a 0xea0 0xea6 0xeab 0xeb7 0xec9>;
				ocv_soc_70 = <0xecf 0xeda 0xee0 0xef2 0xefd 0xf03 0xf09 0xf15 0xf26 0xf2c>;
				ocv_soc_80 = <0xf32 0xf38 0xf4a 0xf4f 0xf5b 0xf67 0xf73 0xf7e 0xf84 0xf8a>;
				ocv_soc_90 = <0xf96 0xfa7 0xfad 0xfb3 0xfb9 0xfbf 0xfd6 0xff9 0x1005 0x1017>;
			};
		};
	};
};
