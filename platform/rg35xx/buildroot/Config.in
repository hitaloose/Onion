## platform/rg35xx/buildroot/Config.in
```kconfig
source "$BR2_EXTERNAL_ONION_RG35XX_PATH/package/onion-customer/Config.in"
source "$BR2_EXTERNAL_ONION_RG35XX_PATH/package/powervr-sgx-um/Config.in"
```

## platform/rg35xx/buildroot/package/onion-customer/Config.in
```kconfig
config BR2_PACKAGE_ONION_CUSTOMER
	bool "onion-customer"
	select BR2_PACKAGE_JQ # jsonval
	help
	  Recreates the parts of the Miyoo Mini /customer/app directory
	  that Onion depends on: the Exo 2 Bold Italic and WenQuanYi
	  Micro Hei fonts, and a jq based jsonval.
```

## platform/rg35xx/buildroot/package/powervr-sgx-um/Config.in
```kconfig
config BR2_PACKAGE_POWERVR_SGX_UM
	bool "powervr-sgx-um"
	select BR2_PACKAGE_LIBDRM # libsrv_um
	select BR2_PACKAGE_HAS_LIBEGL
	select BR2_PACKAGE_HAS_LIBGLES
	help
	  User-space driver of the PowerVR SGX544 (EGL, OpenGL ES 1.1
	  and 2.0) for the Actions S500/ATM7039, DDK 1.14@3625561, from
	  the Cubieboard 6 Ubuntu packages. Matches pvrsrvkm.ko of the
	  Onion kernel (platform/rg35xx/kernel). Only the parts that do
	  not need X11: EGL on the framebuffer through the FLIP window
	  system (/etc/powervr.ini; LINUXFB refuses the display, FRONT and
	  BLIT are installed but untested).

if BR2_PACKAGE_POWERVR_SGX_UM

config BR2_PACKAGE_PROVIDES_LIBEGL
	default "powervr-sgx-um"

config BR2_PACKAGE_PROVIDES_LIBGLES
	default "powervr-sgx-um"

endif
```
