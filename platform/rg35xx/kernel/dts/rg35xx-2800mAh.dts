/* RG35XX with a 2800 mAh battery: battery table from the Garlic misc/dtbs/2800mAh.dtb */
/include/ "rg35xx.dts"

/ {
	i2c@b0174000 {
		atc2603c@65 {
			atc260x-cap-gauge {
				capacity = <0xaf0>;
				ocv_soc_00 = <0xc67 0xc67 0xc7f 0xc96 0xce8 0xcee 0xd00 0xd17 0xd1d 0xd2f>;
				ocv_soc_10 = <0xd34 0xd52 0xd58 0xd5d 0xd63 0xd69 0xd6f 0xd75 0xd81 0xd86>;
				ocv_soc_20 = <0xd8c 0xd92 0xd98 0xd9e 0xdaa 0xdaf 0xdb5 0xdbb 0xdc1 0xdc7>;
				ocv_soc_30 = <0xdcd 0xdd3 0xdd8 0xdde 0xde4 0xdea 0xdf0 0xdf6 0xdfc 0xe01>;
				ocv_soc_40 = <0xe07 0xe0d 0xe13 0xe19 0xe1f 0xe25 0xe2a 0xe30 0xe36 0xe3c>;
				ocv_soc_50 = <0xe42 0xe48 0xe4e 0xe53 0xe59 0xe5f 0xe65 0xe71 0xe7c 0xe82>;
				ocv_soc_60 = <0xe88 0xe8e 0xe94 0xe9a 0xea0 0xea6 0xeab 0xeb7 0xebd 0xec3>;
				ocv_soc_70 = <0xec9 0xecf 0xed4 0xee6 0xeec 0xef2 0xef8 0xf03 0xf09 0xf21>;
				ocv_soc_80 = <0xf26 0xf2c 0xf32 0xf3e 0xf44 0xf4a 0xf4f 0xf55 0xf6d 0xf73>;
				ocv_soc_90 = <0xf78 0xf7e 0xf84 0xf8a 0xf90 0xf9c 0xfa1 0xfb3 0xfb9 0xfd0>;
			};
		};
	};
};
